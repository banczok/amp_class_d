## firmware/esp32c3/main/Kconfig.projbuild
```kconfig
menu "Preamp controller (ESP32-C3)"

config AMP_WIFI_SSID
    string "Home WiFi SSID"
    default ""
    help
        The C3 associates with this network so ESP-NOW runs on the same
        channel the knob will use for album art.  Leave empty to run
        ESP-NOW only, on AMP_ESPNOW_CHANNEL.

config AMP_WIFI_PASS
    string "Home WiFi password"
    default ""

config AMP_ESPNOW_CHANNEL
    int "Fallback ESP-NOW channel"
    range 1 13
    default 1
    help
        Used when no SSID is configured, or before association
        completes.  The knob must fall back to the same number.

config AMP_ESPNOW_ENCRYPT
    bool "Encrypt ESP-NOW unicast"
    default n
    help
        Enables ESP-NOW LMK/PMK encryption on the knob link.  Both ends
        must be built with the same keys.  Broadcast discovery frames are
        never encrypted, so pairing still works either way.

config AMP_ESPNOW_PMK
    string "ESP-NOW primary master key (16 chars)"
    depends on AMP_ESPNOW_ENCRYPT
    default "amp-ctrl-pmk-001"

config AMP_ESPNOW_LMK
    string "ESP-NOW local master key (16 chars)"
    depends on AMP_ESPNOW_ENCRYPT
    default "amp-ctrl-lmk-001"

endmenu
```

## firmware/knob/main/Kconfig.projbuild
```kconfig
menu "Preamp knob remote"

config KNOB_WIFI_SSID
    string "Home WiFi SSID"
    default ""
    help
        Used only to fetch the album cover.  Control runs over ESP-NOW
        and works with this left empty - you just get no artwork.

config KNOB_WIFI_PASS
    string "Home WiFi password"
    default ""

config KNOB_FALLBACK_CHANNEL
    int "Fallback ESP-NOW channel"
    range 1 13
    default 1
    help
        Used on the very first wake, before the knob has ever
        associated and cached the real channel.  Must match
        AMP_ESPNOW_CHANNEL on the amplifier's C3.

config KNOB_PI_BASE_URL
    string "Base URL for the cover endpoint on the Pi"
    default "http://moode.local/amp"
    help
        The knob GETs <base>/cover.jpg?id=N and expects a 480x480
        baseline JPEG.  Scaling happens on the Pi: it has the CPU, and
        an arbitrary-size cover would need a second full-screen buffer
        plus a resampler on this chip.

endmenu
```
